/* Copyright (c) 2014-2015, The Linux Foundation. All rights reserved.
 *
 * This program is free software; you can redistribute it and/or modify
 * it under the terms of the GNU General Public License version 2 and
 * only version 2 as published by the Free Software Foundation.
 *
 * This program is distributed in the hope that it will be useful,
 * but WITHOUT ANY WARRANTY; without even the implied warranty of
 * MERCHANTABILITY or FITNESS FOR A PARTICULAR PURPOSE.  See the
 * GNU General Public License for more details.
 */

/dts-v1/;

#include "msm8916-oppo-a37f.dtsi"
#include "msm8916-memory.dtsi"

/ {
	model = "OPPO A37f (msm8916, arm64)";
	compatible = "qcom,msm8916-mtp", "qcom,msm8916", "qcom,mtp";
	qcom,board-id = <8 0 15399>;

	/* live.dts memory/nvbackup_regions@0: reserve the opponvbk NV-backup
	 * window so the kernel leaves it for the sharedmem-uio device. */
	memory {
		nvbackup_mem: nvbackup_region@85f00000 {
			linux,reserve-region;
			linux,remove-completely;
			reg = <0x0 0x85f00000 0x0 0x100000>;
			label = "memory_nvbackup";
		};
	};
};
