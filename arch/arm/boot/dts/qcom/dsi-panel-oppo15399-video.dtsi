/* OPPO A37f (15399) DSI panels — ported verbatim from the live device-tree
 * dump: ~/a37f-dumps/live-refs/live-dt/soc/qcom,mdss_mdp@1a00000/<node>
 * Regenerated via dtc -I fs from /proc/device-tree (ground truth). The only
 * edit vs the dump: panel-controller phandle -> &mdss_dsi0 (dump 0x60), and
 * the live linux,phandle/phandle/name props stripped (labels supply them).
 * Three variants carried; the DSI ctrl auto-selects (prim=boe, sub/sub1).
 */

&mdss_mdp {
	dsi_oppo15399boe_ili9881c: qcom,mdss_dsi_oppo15399boe_ili9881c_720p_video {
	qcom,mdss-dsi-bllp-power-mode;
	qcom,mdss-dsi-lp11-init;
	qcom,mdss-dsi-panel-status-check-mode = "reg_read";
	qcom,mdss-dsi-lane-2-state;
	qcom,mdss-dsi-panel-width = <0x2d0>;
	qcom,mdss-dsi-bl-min-level = <0x01>;
	qcom,mdss-dsi-h-back-porch = <0xa0>;
	qcom,mdss-dsi-bpp = <0x18>;
	qcom,cont-splash-enabled;
	qcom,mdss-dsi-mdp-trigger = <0x00>;
	qcom,mdss-dsi-bllp-eof-power-mode;
	qcom,mdss-dsi-v-top-border = <0x00>;
	qcom,mdss-dsi-panel-cabc-command = [06 01 00 01 05 00 02 f3 08];
	qcom,mdss-dsi-v-front-porch = <0x18>;
	qcom,mdss-dsi-panel-status-command = [06 01 00 01 05 00 02 0a 08];
	qcom,mdss-dsi-stream = <0x00>;
	qcom,mdss-dsi-hsa-power-mode;
	qcom,mdss-dsi-bl-max-level = <0xff>;
	qcom,mdss-pan-physical-height-dimension = <0x6e>;
	qcom,mdss-dsi-hbp-power-mode;
	qcom,mdss-dsi-panel-version = "ILI9881C";
	qcom,mdss-dsi-tx-eot-append;
	qcom,mdss-dsi-pixel-packing = "tight";
	qcom,mdss-dsi-lane-1-state;
	qcom,mdss-dsi-v-back-porch = <0x18>;
	qcom,mdss-dsi-reset-sequence = <0x01 0x0a 0x00 0x01 0x01 0x0f>;
	qcom,mdss-dsi-on-command-state = "dsi_lp_mode";
	qcom,mdss-dsi-panel-type = "dsi_video_mode";
	qcom,mdss-dsi-h-right-border = <0x00>;
	qcom,mdss-dsi-off-command = [39 01 00 00 32 00 04 ff 98 81 0b 05 01 00 00 32 00 02 28 00 05 01 00 00 78 00 02 10 00];
	qcom,mdss-dsi-traffic-mode = "burst_mode";
	qcom,mdss-dsi-t-clk-pre = <0x24>;
	qcom,mdss-dsi-lane-map = "lane_map_0123";
	qcom,mdss-dsi-hfp-power-mode;
	qcom,mdss-dsi-h-front-porch = <0xa4>;
	qcom,mdss-dsi-panel-destination = "display_1";
	qcom,mdss-dsi-panel-height = <0x500>;
	qcom,mdss-dsi-panel-status-value = <0x9c>;
	qcom,mdss-dsi-h-sync-skew = <0x00>;
	qcom,mdss-pan-physical-width-dimension = <0x3e>;
	qcom,mdss-dsi-h-left-border = <0x00>;
	qcom,mdss-dsi-panel-framerate = <0x3c>;
	qcom,mdss-dsi-cabc-still-image-command = <0x39010000 0x4ff 0x98810105 0x1000078 0x2f301 0x39010000 0x4ff 0x98810005 0x1000078 0x22900>;
	qcom,mdss-dsi-off-command-state = "dsi_hs_mode";
	qcom,mdss-dsi-underflow-color = <0xff>;
	qcom,mdss-dsi-t-clk-post = <0x04>;
	qcom,mdss-dsi-panel-manufacture = "Boe_0415";
	qcom,mdss-dsi-on-command = [39 01 00 00 00 00 04 ff 98 81 03 39 01 00 00 00 00 02 01 00 39 01 00 00 00 00 02 02 00 39 01 00 00 00 00 02 03 73 39 01 00 00 00 00 02 04 00 39 01 00 00 00 00 02 05 00 39 01 00 00 00 00 02 06 08 39 01 00 00 00 00 02 07 00 39 01 00 00 00 00 02 08 00 39 01 00 00 00 00 02 09 1b 39 01 00 00 00 00 02 0a 01 39 01 00 00 00 00 02 0b 01 39 01 00 00 00 00 02 0c 0d 39 01 00 00 00 00 02 0d 01 39 01 00 00 00 00 02 0e 01 39 01 00 00 00 00 02 0f 26 39 01 00 00 00 00 02 10 26 39 01 00 00 00 00 02 11 00 39 01 00 00 00 00 02 12 00 39 01 00 00 00 00 02 13 02 39 01 00 00 00 00 02 14 00 39 01 00 00 00 00 02 15 00 39 01 00 00 00 00 02 16 00 39 01 00 00 00 00 02 17 00 39 01 00 00 00 00 02 18 00 39 01 00 00 00 00 02 19 00 39 01 00 00 00 00 02 1a 00 39 01 00 00 00 00 02 1b 00 39 01 00 00 00 00 02 1c 00 39 01 00 00 00 00 02 1d 00 39 01 00 00 00 00 02 1e 40 39 01 00 00 00 00 02 1f 00 39 01 00 00 00 00 02 20 06 39 01 00 00 00 00 02 21 01 39 01 00 00 00 00 02 22 00 39 01 00 00 00 00 02 23 00 39 01 00 00 00 00 02 24 00 39 01 00 00 00 00 02 25 00 39 01 00 00 00 00 02 26 00 39 01 00 00 00 00 02 27 00 39 01 00 00 00 00 02 28 33 39 01 00 00 00 00 02 29 03 39 01 00 00 00 00 02 2a 00 39 01 00 00 00 00 02 2b 00 39 01 00 00 00 00 02 2c 00 39 01 00 00 00 00 02 2d 00 39 01 00 00 00 00 02 2e 00 39 01 00 00 00 00 02 2f 00 39 01 00 00 00 00 02 30 00 39 01 00 00 00 00 02 31 00 39 01 00 00 00 00 02 32 00 39 01 00 00 00 00 02 33 00 39 01 00 00 00 00 02 34 00 39 01 00 00 00 00 02 35 00 39 01 00 00 00 00 02 36 00 39 01 00 00 00 00 02 37 00 39 01 00 00 00 00 02 38 00 39 01 00 00 00 00 02 39 00 39 01 00 00 00 00 02 3a 00 39 01 00 00 00 00 02 3b 00 39 01 00 00 00 00 02 3c 00 39 01 00 00 00 00 02 3d 00 39 01 00 00 00 00 02 3e 00 39 01 00 00 00 00 02 3f 00 39 01 00 00 00 00 02 40 00 39 01 00 00 00 00 02 41 00 39 01 00 00 00 00 02 42 00 39 01 00 00 00 00 02 43 00 39 01 00 00 00 00 02 44 00 39 01 00 00 00 00 02 50 01 39 01 00 00 00 00 02 51 23 39 01 00 00 00 00 02 52 45 39 01 00 00 00 00 02 53 67 39 01 00 00 00 00 02 54 89 39 01 00 00 00 00 02 55 ab 39 01 00 00 00 00 02 56 01 39 01 00 00 00 00 02 57 23 39 01 00 00 00 00 02 58 45 39 01 00 00 00 00 02 59 67 39 01 00 00 00 00 02 5a 89 39 01 00 00 00 00 02 5b ab 39 01 00 00 00 00 02 5c cd 39 01 00 00 00 00 02 5d ef 39 01 00 00 00 00 02 5e 11 39 01 00 00 00 00 02 5f 02 39 01 00 00 00 00 02 60 00 39 01 00 00 00 00 02 61 07 39 01 00 00 00 00 02 62 06 39 01 00 00 00 00 02 63 0e 39 01 00 00 00 00 02 64 0f 39 01 00 00 00 00 02 65 0c 39 01 00 00 00 00 02 66 0d 39 01 00 00 00 00 02 67 02 39 01 00 00 00 00 02 68 02 39 01 00 00 00 00 02 69 02 39 01 00 00 00 00 02 6a 02 39 01 00 00 00 00 02 6b 02 39 01 00 00 00 00 02 6c 02 39 01 00 00 00 00 02 6d 02 39 01 00 00 00 00 02 6e 02 39 01 00 00 00 00 02 6f 02 39 01 00 00 00 00 02 70 02 39 01 00 00 00 00 02 71 02 39 01 00 00 00 00 02 72 02 39 01 00 00 00 00 02 73 05 39 01 00 00 00 00 02 74 01 39 01 00 00 00 00 02 75 02 39 01 00 00 00 00 02 76 00 39 01 00 00 00 00 02 77 07 39 01 00 00 00 00 02 78 06 39 01 00 00 00 00 02 79 0e 39 01 00 00 00 00 02 7a 0f 39 01 00 00 00 00 02 7b 0c 39 01 00 00 00 00 02 7c 0d 39 01 00 00 00 00 02 7d 02 39 01 00 00 00 00 02 7e 02 39 01 00 00 00 00 02 7f 02 39 01 00 00 00 00 02 80 02 39 01 00 00 00 00 02 81 02 39 01 00 00 00 00 02 82 02 39 01 00 00 00 00 02 83 02 39 01 00 00 00 00 02 84 02 39 01 00 00 00 00 02 85 02 39 01 00 00 00 00 02 86 02 39 01 00 00 00 00 02 87 02 39 01 00 00 00 00 02 88 02 39 01 00 00 00 00 02 89 05 39 01 00 00 00 00 02 8a 01 39 01 00 00 00 00 04 ff 98 81 04 39 01 00 00 00 00 02 00 00 39 01 00 00 00 00 02 0b 80 39 01 00 00 00 00 02 0e 17 39 01 00 00 00 00 02 6c 15 39 01 00 00 00 00 02 6e 1a 39 01 00 00 00 00 02 6f 25 39 01 00 00 00 00 02 3a a4 39 01 00 00 00 00 02 8d 2a 39 01 00 00 00 00 02 87 ba 39 01 00 00 00 00 02 3b 80 39 01 00 00 00 00 02 7a 10 39 01 00 00 00 00 02 71 b0 39 01 00 00 00 00 04 ff 98 81 01 39 01 00 00 00 00 02 22 0a 39 01 00 00 00 00 02 53 7d 39 01 00 00 00 00 02 55 8a 39 01 00 00 00 00 02 50 85 39 01 00 00 00 00 02 51 82 39 01 00 00 00 00 02 31 00 39 01 00 00 00 00 02 40 33 39 01 00 00 00 00 02 43 66 39 01 00 00 00 00 02 60 19 39 01 00 00 00 00 02 61 01 39 01 00 00 00 00 02 62 0c 39 01 00 00 00 00 02 63 00 39 01 00 00 00 00 04 ff 98 81 05 39 01 00 00 00 00 02 80 01 39 01 00 00 00 00 04 ff 98 81 01 39 01 00 00 00 00 02 34 01 39 01 00 00 00 00 02 a0 06 39 01 00 00 00 00 02 a1 13 39 01 00 00 00 00 02 a2 21 39 01 00 00 00 00 02 a3 11 39 01 00 00 00 00 02 a4 15 39 01 00 00 00 00 02 a5 23 39 01 00 00 00 00 02 a6 1a 39 01 00 00 00 00 02 a7 1c 39 01 00 00 00 00 02 a8 77 39 01 00 00 00 00 02 a9 1c 39 01 00 00 00 00 02 aa 29 39 01 00 00 00 00 02 ab 6f 39 01 00 00 00 00 02 ac 13 39 01 00 00 00 00 02 ad 0d 39 01 00 00 00 00 02 ae 3d 39 01 00 00 00 00 02 af 0a 39 01 00 00 00 00 02 b0 18 39 01 00 00 00 00 02 b1 61 39 01 00 00 00 00 02 b2 74 39 01 00 00 00 00 02 b3 39 39 01 00 00 00 00 02 c0 05 39 01 00 00 00 00 02 c1 12 39 01 00 00 00 00 02 c2 20 39 01 00 00 00 00 02 c3 12 39 01 00 00 00 00 02 c4 15 39 01 00 00 00 00 02 c5 24 39 01 00 00 00 00 02 c6 1a 39 01 00 00 00 00 02 c7 1c 39 01 00 00 00 00 02 c8 76 39 01 00 00 00 00 02 c9 1c 39 01 00 00 00 00 02 ca 29 39 01 00 00 00 00 02 cb 6e 39 01 00 00 00 00 02 cc 13 39 01 00 00 00 00 02 cd 0d 39 01 00 00 00 00 02 ce 3d 39 01 00 00 00 00 02 cf 0a 39 01 00 00 00 00 02 d0 19 39 01 00 00 00 00 02 d1 60 39 01 00 00 00 00 02 d2 73 39 01 00 00 00 00 02 d3 39 39 01 00 00 00 00 04 ff 98 81 05 39 01 00 00 00 00 02 00 00 39 01 00 00 00 00 02 01 00 39 01 00 00 00 00 02 02 00 39 01 00 00 00 00 02 03 00 39 01 00 00 00 00 02 04 00 39 01 00 00 00 00 02 05 00 39 01 00 00 00 00 02 06 00 39 01 00 00 00 00 02 07 81 39 01 00 00 00 00 02 08 81 39 01 00 00 00 00 02 09 81 39 01 00 00 00 00 02 0a 81 39 01 00 00 00 00 02 0b 81 39 01 00 00 00 00 02 0c 81 39 01 00 00 00 00 02 0d 81 39 01 00 00 00 00 02 0e 81 39 01 00 00 00 00 02 0f 81 39 01 00 00 00 00 02 10 81 39 01 00 00 00 00 02 11 81 39 01 00 00 00 00 02 12 81 39 01 00 00 00 00 02 13 81 39 01 00 00 00 00 02 14 81 39 01 00 00 00 00 02 15 82 39 01 00 00 00 00 02 16 82 39 01 00 00 00 00 02 17 82 39 01 00 00 00 00 02 18 82 39 01 00 00 00 00 02 19 82 39 01 00 00 00 00 02 1a 82 39 01 00 00 00 00 02 1b 82 39 01 00 00 00 00 02 1c 82 39 01 00 00 00 00 02 1d 82 39 01 00 00 00 00 02 1e 82 39 01 00 00 00 00 02 1f 82 39 01 00 00 00 00 02 20 82 39 01 00 00 00 00 02 21 82 39 01 00 00 00 00 02 22 83 39 01 00 00 00 00 02 23 83 39 01 00 00 00 00 02 24 83 39 01 00 00 00 00 02 25 83 39 01 00 00 00 00 02 26 83 39 01 00 00 00 00 02 27 83 39 01 00 00 00 00 02 28 83 39 01 00 00 00 00 02 29 83 39 01 00 00 00 00 02 2a 83 39 01 00 00 00 00 02 2b 83 39 01 00 00 00 00 02 2c 83 39 01 00 00 00 00 02 2d 83 39 01 00 00 00 00 02 2e 83 39 01 00 00 00 00 02 2f 83 39 01 00 00 00 00 02 30 84 39 01 00 00 00 00 02 31 84 39 01 00 00 00 00 02 32 84 39 01 00 00 00 00 02 33 84 39 01 00 00 00 00 02 34 84 39 01 00 00 00 00 02 35 84 39 01 00 00 00 00 02 36 84 39 01 00 00 00 00 02 37 84 39 01 00 00 00 00 02 38 84 39 01 00 00 00 00 02 39 84 39 01 00 00 00 00 02 3a 84 39 01 00 00 00 00 02 3b 84 39 01 00 00 00 00 02 3c 84 39 01 00 00 00 00 02 3d 85 39 01 00 00 00 00 02 3e 85 39 01 00 00 00 00 02 3f 85 39 01 00 00 00 00 02 40 85 39 01 00 00 00 00 02 41 85 39 01 00 00 00 00 02 42 85 39 01 00 00 00 00 02 43 85 39 01 00 00 00 00 02 44 85 39 01 00 00 00 00 02 45 85 39 01 00 00 00 00 02 46 85 39 01 00 00 00 00 02 47 85 39 01 00 00 00 00 02 48 85 39 01 00 00 00 00 02 49 85 39 01 00 00 00 00 02 4a 85 39 01 00 00 00 00 02 4b 86 39 01 00 00 00 00 02 4c 86 39 01 00 00 00 00 02 4d 86 39 01 00 00 00 00 02 4e 86 39 01 00 00 00 00 02 4f 86 39 01 00 00 00 00 02 50 86 39 01 00 00 00 00 02 51 86 39 01 00 00 00 00 02 52 86 39 01 00 00 00 00 02 53 86 39 01 00 00 00 00 02 54 86 39 01 00 00 00 00 02 55 86 39 01 00 00 00 00 02 56 86 39 01 00 00 00 00 02 57 86 39 01 00 00 00 00 02 58 87 39 01 00 00 00 00 02 59 87 39 01 00 00 00 00 02 5a 87 39 01 00 00 00 00 02 5b 87 39 01 00 00 00 00 02 5c 87 39 01 00 00 00 00 02 5d 87 39 01 00 00 00 00 02 5e 87 39 01 00 00 00 00 02 5f 87 39 01 00 00 00 00 02 60 87 39 01 00 00 00 00 02 61 87 39 01 00 00 00 00 02 62 87 39 01 00 00 00 00 02 63 87 39 01 00 00 00 00 02 64 87 39 01 00 00 00 00 02 65 87 39 01 00 00 00 00 02 66 88 39 01 00 00 00 00 02 67 88 39 01 00 00 00 00 02 68 88 39 01 00 00 00 00 02 69 88 39 01 00 00 00 00 02 6a 88 39 01 00 00 00 00 02 6b 88 39 01 00 00 00 00 02 6c 88 39 01 00 00 00 00 02 6d 88 39 01 00 00 00 00 02 6e 88 39 01 00 00 00 00 02 6f 88 39 01 00 00 00 00 02 70 88 39 01 00 00 00 00 02 71 88 39 01 00 00 00 00 02 72 88 39 01 00 00 00 00 02 73 89 39 01 00 00 00 00 02 74 89 39 01 00 00 00 00 02 75 89 39 01 00 00 00 00 02 76 89 39 01 00 00 00 00 02 77 89 39 01 00 00 00 00 02 78 89 39 01 00 00 00 00 02 79 89 39 01 00 00 00 00 02 7a 89 39 01 00 00 00 00 02 7b 89 39 01 00 00 00 00 02 7c 89 39 01 00 00 00 00 02 7d 89 39 01 00 00 00 00 02 7e 89 39 01 00 00 00 00 02 7f 89 39 01 00 00 00 00 04 ff 98 81 06 39 01 00 00 00 00 02 00 89 39 01 00 00 00 00 02 01 8a 39 01 00 00 00 00 02 02 8a 39 01 00 00 00 00 02 03 8a 39 01 00 00 00 00 02 04 8a 39 01 00 00 00 00 02 05 8a 39 01 00 00 00 00 02 06 8a 39 01 00 00 00 00 02 07 8a 39 01 00 00 00 00 02 08 8a 39 01 00 00 00 00 02 09 8a 39 01 00 00 00 00 02 0a 8a 39 01 00 00 00 00 02 0b 8a 39 01 00 00 00 00 02 0c 8a 39 01 00 00 00 00 02 0d 8a 39 01 00 00 00 00 02 0e 8b 39 01 00 00 00 00 02 0f 8b 39 01 00 00 00 00 02 10 8b 39 01 00 00 00 00 02 11 8b 39 01 00 00 00 00 02 12 8b 39 01 00 00 00 00 02 13 8b 39 01 00 00 00 00 02 14 8b 39 01 00 00 00 00 02 15 8b 39 01 00 00 00 00 02 16 8b 39 01 00 00 00 00 02 17 8b 39 01 00 00 00 00 02 18 8b 39 01 00 00 00 00 02 19 8b 39 01 00 00 00 00 02 1a 8b 39 01 00 00 00 00 02 1b 8c 39 01 00 00 00 00 02 1c 8c 39 01 00 00 00 00 02 1d 8c 39 01 00 00 00 00 02 1e 8c 39 01 00 00 00 00 02 1f 8c 39 01 00 00 00 00 02 20 8c 39 01 00 00 00 00 02 21 8c 39 01 00 00 00 00 02 22 8c 39 01 00 00 00 00 02 23 8c 39 01 00 00 00 00 02 24 8c 39 01 00 00 00 00 02 25 8c 39 01 00 00 00 00 02 26 8c 39 01 00 00 00 00 02 27 8c 39 01 00 00 00 00 02 28 8c 39 01 00 00 00 00 02 29 8d 39 01 00 00 00 00 02 2a 8d 39 01 00 00 00 00 02 2b 8d 39 01 00 00 00 00 02 2c 8d 39 01 00 00 00 00 02 2d 8d 39 01 00 00 00 00 02 2e 8d 39 01 00 00 00 00 02 2f 8d 39 01 00 00 00 00 02 30 8d 39 01 00 00 00 00 02 31 8d 39 01 00 00 00 00 02 32 8d 39 01 00 00 00 00 02 33 8d 39 01 00 00 00 00 02 34 8d 39 01 00 00 00 00 02 35 8d 39 01 00 00 00 00 02 36 8e 39 01 00 00 00 00 02 37 8e 39 01 00 00 00 00 02 38 8e 39 01 00 00 00 00 02 39 8e 39 01 00 00 00 00 02 3a 8e 39 01 00 00 00 00 02 3b 8e 39 01 00 00 00 00 02 3c 8e 39 01 00 00 00 00 02 3d 8e 39 01 00 00 00 00 02 3e 8e 39 01 00 00 00 00 02 3f 8e 39 01 00 00 00 00 02 40 8e 39 01 00 00 00 00 02 41 8e 39 01 00 00 00 00 02 42 8e 39 01 00 00 00 00 02 43 8e 39 01 00 00 00 00 02 44 8f 39 01 00 00 00 00 02 45 8f 39 01 00 00 00 00 02 46 8f 39 01 00 00 00 00 02 47 8f 39 01 00 00 00 00 02 48 8f 39 01 00 00 00 00 02 49 8f 39 01 00 00 00 00 02 4a 8f 39 01 00 00 00 00 02 4b 8f 39 01 00 00 00 00 02 4c 8f 39 01 00 00 00 00 02 4d 8f 39 01 00 00 00 00 02 4e 8f 39 01 00 00 00 00 02 4f 8f 39 01 00 00 00 00 02 50 8f 39 01 00 00 00 00 02 51 90 39 01 00 00 00 00 02 52 90 39 01 00 00 00 00 02 53 90 39 01 00 00 00 00 02 54 90 39 01 00 00 00 00 02 55 90 39 01 00 00 00 00 02 56 90 39 01 00 00 00 00 02 57 90 39 01 00 00 00 00 02 58 90 39 01 00 00 00 00 02 59 90 39 01 00 00 00 00 02 5a 90 39 01 00 00 00 00 02 5b 90 39 01 00 00 00 00 02 5c 90 39 01 00 00 00 00 02 5d 90 39 01 00 00 00 00 02 5e 90 39 01 00 00 00 00 02 5f 91 39 01 00 00 00 00 02 60 91 39 01 00 00 00 00 02 61 91 39 01 00 00 00 00 02 62 91 39 01 00 00 00 00 02 63 91 39 01 00 00 00 00 02 64 91 39 01 00 00 00 00 02 65 91 39 01 00 00 00 00 02 66 91 39 01 00 00 00 00 02 67 91 39 01 00 00 00 00 02 68 91 39 01 00 00 00 00 02 69 91 39 01 00 00 00 00 02 6a 91 39 01 00 00 00 00 02 6b 91 39 01 00 00 00 00 02 6c 92 39 01 00 00 00 00 02 6d 92 39 01 00 00 00 00 02 6e 92 39 01 00 00 00 00 02 6f 92 39 01 00 00 00 00 02 70 92 39 01 00 00 00 00 02 71 92 39 01 00 00 00 00 02 72 92 39 01 00 00 00 00 02 73 92 39 01 00 00 00 00 02 74 92 39 01 00 00 00 00 02 75 92 39 01 00 00 00 00 02 76 92 39 01 00 00 00 00 02 77 92 39 01 00 00 00 00 02 78 92 39 01 00 00 00 00 02 79 92 39 01 00 00 00 00 02 7a 93 39 01 00 00 00 00 02 7b 93 39 01 00 00 00 00 02 7c 93 39 01 00 00 00 00 02 7d 93 39 01 00 00 00 00 02 7e 93 39 01 00 00 00 00 02 7f 93 39 01 00 00 00 00 04 ff 98 81 07 39 01 00 00 00 00 02 00 00 39 01 00 00 00 00 02 01 00 39 01 00 00 00 00 02 02 00 39 01 00 00 00 00 02 03 00 39 01 00 00 00 00 02 04 00 39 01 00 00 00 00 02 05 00 39 01 00 00 00 00 02 06 00 39 01 00 00 00 00 02 07 81 39 01 00 00 00 00 02 08 81 39 01 00 00 00 00 02 09 81 39 01 00 00 00 00 02 0a 81 39 01 00 00 00 00 02 0b 81 39 01 00 00 00 00 02 0c 81 39 01 00 00 00 00 02 0d 81 39 01 00 00 00 00 02 0e 81 39 01 00 00 00 00 02 0f 81 39 01 00 00 00 00 02 10 81 39 01 00 00 00 00 02 11 81 39 01 00 00 00 00 02 12 81 39 01 00 00 00 00 02 13 81 39 01 00 00 00 00 02 14 81 39 01 00 00 00 00 02 15 82 39 01 00 00 00 00 02 16 82 39 01 00 00 00 00 02 17 82 39 01 00 00 00 00 02 18 82 39 01 00 00 00 00 02 19 82 39 01 00 00 00 00 02 1a 82 39 01 00 00 00 00 02 1b 82 39 01 00 00 00 00 02 1c 82 39 01 00 00 00 00 02 1d 82 39 01 00 00 00 00 02 1e 82 39 01 00 00 00 00 02 1f 82 39 01 00 00 00 00 02 20 82 39 01 00 00 00 00 02 21 82 39 01 00 00 00 00 02 22 83 39 01 00 00 00 00 02 23 83 39 01 00 00 00 00 02 24 83 39 01 00 00 00 00 02 25 83 39 01 00 00 00 00 02 26 83 39 01 00 00 00 00 02 27 83 39 01 00 00 00 00 02 28 83 39 01 00 00 00 00 02 29 83 39 01 00 00 00 00 02 2a 83 39 01 00 00 00 00 02 2b 83 39 01 00 00 00 00 02 2c 83 39 01 00 00 00 00 02 2d 83 39 01 00 00 00 00 02 2e 83 39 01 00 00 00 00 02 2f 83 39 01 00 00 00 00 02 30 84 39 01 00 00 00 00 02 31 84 39 01 00 00 00 00 02 32 84 39 01 00 00 00 00 02 33 84 39 01 00 00 00 00 02 34 84 39 01 00 00 00 00 02 35 84 39 01 00 00 00 00 02 36 84 39 01 00 00 00 00 02 37 84 39 01 00 00 00 00 02 38 84 39 01 00 00 00 00 02 39 84 39 01 00 00 00 00 02 3a 84 39 01 00 00 00 00 02 3b 84 39 01 00 00 00 00 02 3c 84 39 01 00 00 00 00 02 3d 85 39 01 00 00 00 00 02 3e 85 39 01 00 00 00 00 02 3f 85 39 01 00 00 00 00 02 40 85 39 01 00 00 00 00 02 41 85 39 01 00 00 00 00 02 42 85 39 01 00 00 00 00 02 43 85 39 01 00 00 00 00 02 44 85 39 01 00 00 00 00 02 45 85 39 01 00 00 00 00 02 46 85 39 01 00 00 00 00 02 47 85 39 01 00 00 00 00 02 48 85 39 01 00 00 00 00 02 49 85 39 01 00 00 00 00 02 4a 85 39 01 00 00 00 00 02 4b 86 39 01 00 00 00 00 02 4c 86 39 01 00 00 00 00 02 4d 86 39 01 00 00 00 00 02 4e 86 39 01 00 00 00 00 02 4f 86 39 01 00 00 00 00 02 50 86 39 01 00 00 00 00 02 51 86 39 01 00 00 00 00 02 52 86 39 01 00 00 00 00 02 53 86 39 01 00 00 00 00 02 54 86 39 01 00 00 00 00 02 55 86 39 01 00 00 00 00 02 56 86 39 01 00 00 00 00 02 57 86 39 01 00 00 00 00 02 58 87 39 01 00 00 00 00 02 59 87 39 01 00 00 00 00 02 5a 87 39 01 00 00 00 00 02 5b 87 39 01 00 00 00 00 02 5c 87 39 01 00 00 00 00 02 5d 87 39 01 00 00 00 00 02 5e 87 39 01 00 00 00 00 02 5f 87 39 01 00 00 00 00 02 60 87 39 01 00 00 00 00 02 61 87 39 01 00 00 00 00 02 62 87 39 01 00 00 00 00 02 63 87 39 01 00 00 00 00 02 64 87 39 01 00 00 00 00 02 65 87 39 01 00 00 00 00 02 66 88 39 01 00 00 00 00 02 67 88 39 01 00 00 00 00 02 68 88 39 01 00 00 00 00 02 69 88 39 01 00 00 00 00 02 6a 88 39 01 00 00 00 00 02 6b 88 39 01 00 00 00 00 02 6c 88 39 01 00 00 00 00 02 6d 88 39 01 00 00 00 00 02 6e 88 39 01 00 00 00 00 02 6f 88 39 01 00 00 00 00 02 70 88 39 01 00 00 00 00 02 71 88 39 01 00 00 00 00 02 72 88 39 01 00 00 00 00 02 73 89 39 01 00 00 00 00 02 74 89 39 01 00 00 00 00 02 75 89 39 01 00 00 00 00 02 76 89 39 01 00 00 00 00 02 77 89 39 01 00 00 00 00 02 78 89 39 01 00 00 00 00 02 79 89 39 01 00 00 00 00 02 7a 89 39 01 00 00 00 00 02 7b 89 39 01 00 00 00 00 02 7c 89 39 01 00 00 00 00 02 7d 89 39 01 00 00 00 00 02 7e 89 39 01 00 00 00 00 02 7f 89 39 01 00 00 00 00 04 ff 98 81 08 39 01 00 00 00 00 02 00 89 39 01 00 00 00 00 02 01 8a 39 01 00 00 00 00 02 02 8a 39 01 00 00 00 00 02 03 8a 39 01 00 00 00 00 02 04 8a 39 01 00 00 00 00 02 05 8a 39 01 00 00 00 00 02 06 8a 39 01 00 00 00 00 02 07 8a 39 01 00 00 00 00 02 08 8a 39 01 00 00 00 00 02 09 8a 39 01 00 00 00 00 02 0a 8a 39 01 00 00 00 00 02 0b 8a 39 01 00 00 00 00 02 0c 8a 39 01 00 00 00 00 02 0d 8a 39 01 00 00 00 00 02 0e 8b 39 01 00 00 00 00 02 0f 8b 39 01 00 00 00 00 02 10 8b 39 01 00 00 00 00 02 11 8b 39 01 00 00 00 00 02 12 8b 39 01 00 00 00 00 02 13 8b 39 01 00 00 00 00 02 14 8b 39 01 00 00 00 00 02 15 8b 39 01 00 00 00 00 02 16 8b 39 01 00 00 00 00 02 17 8b 39 01 00 00 00 00 02 18 8b 39 01 00 00 00 00 02 19 8b 39 01 00 00 00 00 02 1a 8b 39 01 00 00 00 00 02 1b 8c 39 01 00 00 00 00 02 1c 8c 39 01 00 00 00 00 02 1d 8c 39 01 00 00 00 00 02 1e 8c 39 01 00 00 00 00 02 1f 8c 39 01 00 00 00 00 02 20 8c 39 01 00 00 00 00 02 21 8c 39 01 00 00 00 00 02 22 8c 39 01 00 00 00 00 02 23 8c 39 01 00 00 00 00 02 24 8c 39 01 00 00 00 00 02 25 8c 39 01 00 00 00 00 02 26 8c 39 01 00 00 00 00 02 27 8c 39 01 00 00 00 00 02 28 8c 39 01 00 00 00 00 02 29 8d 39 01 00 00 00 00 02 2a 8d 39 01 00 00 00 00 02 2b 8d 39 01 00 00 00 00 02 2c 8d 39 01 00 00 00 00 02 2d 8d 39 01 00 00 00 00 02 2e 8d 39 01 00 00 00 00 02 2f 8d 39 01 00 00 00 00 02 30 8d 39 01 00 00 00 00 02 31 8d 39 01 00 00 00 00 02 32 8d 39 01 00 00 00 00 02 33 8d 39 01 00 00 00 00 02 34 8d 39 01 00 00 00 00 02 35 8d 39 01 00 00 00 00 02 36 8e 39 01 00 00 00 00 02 37 8e 39 01 00 00 00 00 02 38 8e 39 01 00 00 00 00 02 39 8e 39 01 00 00 00 00 02 3a 8e 39 01 00 00 00 00 02 3b 8e 39 01 00 00 00 00 02 3c 8e 39 01 00 00 00 00 02 3d 8e 39 01 00 00 00 00 02 3e 8e 39 01 00 00 00 00 02 3f 8e 39 01 00 00 00 00 02 40 8e 39 01 00 00 00 00 02 41 8e 39 01 00 00 00 00 02 42 8e 39 01 00 00 00 00 02 43 8e 39 01 00 00 00 00 02 44 8f 39 01 00 00 00 00 02 45 8f 39 01 00 00 00 00 02 46 8f 39 01 00 00 00 00 02 47 8f 39 01 00 00 00 00 02 48 8f 39 01 00 00 00 00 02 49 8f 39 01 00 00 00 00 02 4a 8f 39 01 00 00 00 00 02 4b 8f 39 01 00 00 00 00 02 4c 8f 39 01 00 00 00 00 02 4d 8f 39 01 00 00 00 00 02 4e 8f 39 01 00 00 00 00 02 4f 8f 39 01 00 00 00 00 02 50 8f 39 01 00 00 00 00 02 51 90 39 01 00 00 00 00 02 52 90 39 01 00 00 00 00 02 53 90 39 01 00 00 00 00 02 54 90 39 01 00 00 00 00 02 55 90 39 01 00 00 00 00 02 56 90 39 01 00 00 00 00 02 57 90 39 01 00 00 00 00 02 58 90 39 01 00 00 00 00 02 59 90 39 01 00 00 00 00 02 5a 90 39 01 00 00 00 00 02 5b 90 39 01 00 00 00 00 02 5c 90 39 01 00 00 00 00 02 5d 90 39 01 00 00 00 00 02 5e 90 39 01 00 00 00 00 02 5f 91 39 01 00 00 00 00 02 60 91 39 01 00 00 00 00 02 61 91 39 01 00 00 00 00 02 62 91 39 01 00 00 00 00 02 63 91 39 01 00 00 00 00 02 64 91 39 01 00 00 00 00 02 65 91 39 01 00 00 00 00 02 66 91 39 01 00 00 00 00 02 67 91 39 01 00 00 00 00 02 68 91 39 01 00 00 00 00 02 69 91 39 01 00 00 00 00 02 6a 91 39 01 00 00 00 00 02 6b 91 39 01 00 00 00 00 02 6c 92 39 01 00 00 00 00 02 6d 92 39 01 00 00 00 00 02 6e 92 39 01 00 00 00 00 02 6f 92 39 01 00 00 00 00 02 70 92 39 01 00 00 00 00 02 71 92 39 01 00 00 00 00 02 72 92 39 01 00 00 00 00 02 73 92 39 01 00 00 00 00 02 74 92 39 01 00 00 00 00 02 75 92 39 01 00 00 00 00 02 76 92 39 01 00 00 00 00 02 77 92 39 01 00 00 00 00 02 78 92 39 01 00 00 00 00 02 79 92 39 01 00 00 00 00 02 7a 93 39 01 00 00 00 00 02 7b 93 39 01 00 00 00 00 02 7c 93 39 01 00 00 00 00 02 7d 93 39 01 00 00 00 00 02 7e 93 39 01 00 00 00 00 02 7f 93 39 01 00 00 00 00 04 ff 98 81 09 39 01 00 00 00 00 02 00 00 39 01 00 00 00 00 02 01 00 39 01 00 00 00 00 02 02 00 39 01 00 00 00 00 02 03 00 39 01 00 00 00 00 02 04 00 39 01 00 00 00 00 02 05 00 39 01 00 00 00 00 02 06 00 39 01 00 00 00 00 02 07 00 39 01 00 00 00 00 02 08 00 39 01 00 00 00 00 02 09 00 39 01 00 00 00 00 02 0a 00 39 01 00 00 00 00 02 0b 00 39 01 00 00 00 00 02 0c 00 39 01 00 00 00 00 02 0d 00 39 01 00 00 00 00 02 0e 00 39 01 00 00 00 00 02 0f 00 39 01 00 00 00 00 02 10 00 39 01 00 00 00 00 02 11 00 39 01 00 00 00 00 02 12 00 39 01 00 00 00 00 02 13 00 39 01 00 00 00 00 02 14 00 39 01 00 00 00 00 02 15 00 39 01 00 00 00 00 02 16 00 39 01 00 00 00 00 02 17 00 39 01 00 00 00 00 02 18 00 39 01 00 00 00 00 02 19 00 39 01 00 00 00 00 02 1a 00 39 01 00 00 00 00 02 1b 00 39 01 00 00 00 00 02 1c 00 39 01 00 00 00 00 02 1d 00 39 01 00 00 00 00 02 1e 00 39 01 00 00 00 00 02 1f 00 39 01 00 00 00 00 02 20 00 39 01 00 00 00 00 02 21 00 39 01 00 00 00 00 02 22 00 39 01 00 00 00 00 02 23 00 39 01 00 00 00 00 02 24 00 39 01 00 00 00 00 02 25 00 39 01 00 00 00 00 02 26 00 39 01 00 00 00 00 02 27 00 39 01 00 00 00 00 02 28 00 39 01 00 00 00 00 02 29 00 39 01 00 00 00 00 02 2a 00 39 01 00 00 00 00 02 2b 00 39 01 00 00 00 00 02 2c 00 39 01 00 00 00 00 02 2d 00 39 01 00 00 00 00 02 2e 00 39 01 00 00 00 00 02 2f 00 39 01 00 00 00 00 02 30 00 39 01 00 00 00 00 02 31 00 39 01 00 00 00 00 02 32 00 39 01 00 00 00 00 02 33 00 39 01 00 00 00 00 02 34 00 39 01 00 00 00 00 02 35 00 39 01 00 00 00 00 02 36 00 39 01 00 00 00 00 02 37 00 39 01 00 00 00 00 02 38 00 39 01 00 00 00 00 02 39 00 39 01 00 00 00 00 02 3a 00 39 01 00 00 00 00 02 3b 00 39 01 00 00 00 00 02 3c 00 39 01 00 00 00 00 02 3d 00 39 01 00 00 00 00 02 3e 00 39 01 00 00 00 00 02 3f 00 39 01 00 00 00 00 02 40 00 39 01 00 00 00 00 02 41 00 39 01 00 00 00 00 02 42 00 39 01 00 00 00 00 02 43 00 39 01 00 00 00 00 02 44 00 39 01 00 00 00 00 02 45 00 39 01 00 00 00 00 02 46 00 39 01 00 00 00 00 02 47 00 39 01 00 00 00 00 02 48 00 39 01 00 00 00 00 02 49 00 39 01 00 00 00 00 02 4a 00 39 01 00 00 00 00 02 4b 00 39 01 00 00 00 00 02 4c 00 39 01 00 00 00 00 02 4d 00 39 01 00 00 00 00 02 4e 00 39 01 00 00 00 00 02 4f 00 39 01 00 00 00 00 02 50 00 39 01 00 00 00 00 02 51 00 39 01 00 00 00 00 02 52 00 39 01 00 00 00 00 02 53 00 39 01 00 00 00 00 02 54 00 39 01 00 00 00 00 02 55 00 39 01 00 00 00 00 02 56 00 39 01 00 00 00 00 02 57 00 39 01 00 00 00 00 02 58 00 39 01 00 00 00 00 02 59 00 39 01 00 00 00 00 02 5a 00 39 01 00 00 00 00 02 5b 00 39 01 00 00 00 00 02 5c 00 39 01 00 00 00 00 02 5d 00 39 01 00 00 00 00 02 5e 00 39 01 00 00 00 00 02 5f 00 39 01 00 00 00 00 02 60 00 39 01 00 00 00 00 02 61 00 39 01 00 00 00 00 02 62 00 39 01 00 00 00 00 02 63 00 39 01 00 00 00 00 02 64 00 39 01 00 00 00 00 02 65 00 39 01 00 00 00 00 02 66 00 39 01 00 00 00 00 02 67 00 39 01 00 00 00 00 02 68 00 39 01 00 00 00 00 02 69 00 39 01 00 00 00 00 02 6a 00 39 01 00 00 00 00 02 6b 00 39 01 00 00 00 00 02 6c 00 39 01 00 00 00 00 02 6d 00 39 01 00 00 00 00 02 6e 00 39 01 00 00 00 00 02 6f 00 39 01 00 00 00 00 02 70 00 39 01 00 00 00 00 02 71 00 39 01 00 00 00 00 02 72 00 39 01 00 00 00 00 02 73 00 39 01 00 00 00 00 02 74 00 39 01 00 00 00 00 02 75 00 39 01 00 00 00 00 02 76 00 39 01 00 00 00 00 02 77 00 39 01 00 00 00 00 02 78 00 39 01 00 00 00 00 02 79 00 39 01 00 00 00 00 02 7a 00 39 01 00 00 00 00 02 7b 00 39 01 00 00 00 00 02 7c 00 39 01 00 00 00 00 02 7d 00 39 01 00 00 00 00 02 7e 00 39 01 00 00 00 00 02 7f 00 39 01 00 00 00 00 04 ff 98 81 0a 39 01 00 00 00 00 02 00 00 39 01 00 00 00 00 02 01 81 39 01 00 00 00 00 02 02 81 39 01 00 00 00 00 02 03 81 39 01 00 00 00 00 02 04 81 39 01 00 00 00 00 02 05 81 39 01 00 00 00 00 02 06 81 39 01 00 00 00 00 02 07 81 39 01 00 00 00 00 02 08 81 39 01 00 00 00 00 02 09 81 39 01 00 00 00 00 02 0a 81 39 01 00 00 00 00 02 0b 81 39 01 00 00 00 00 02 0c 81 39 01 00 00 00 00 02 0d 81 39 01 00 00 00 00 02 0e 81 39 01 00 00 00 00 02 0f 81 39 01 00 00 00 00 02 10 81 39 01 00 00 00 00 02 11 81 39 01 00 00 00 00 02 12 81 39 01 00 00 00 00 02 13 81 39 01 00 00 00 00 02 14 81 39 01 00 00 00 00 02 15 81 39 01 00 00 00 00 02 16 81 39 01 00 00 00 00 02 17 81 39 01 00 00 00 00 02 18 81 39 01 00 00 00 00 02 19 81 39 01 00 00 00 00 02 1a 81 39 01 00 00 00 00 02 1b 81 39 01 00 00 00 00 02 1c 81 39 01 00 00 00 00 02 1d 81 39 01 00 00 00 00 02 1e 81 39 01 00 00 00 00 02 1f 81 39 01 00 00 00 00 02 20 81 39 01 00 00 00 00 02 21 81 39 01 00 00 00 00 02 22 81 39 01 00 00 00 00 02 23 81 39 01 00 00 00 00 02 24 81 39 01 00 00 00 00 02 25 81 39 01 00 00 00 00 02 26 81 39 01 00 00 00 00 02 27 81 39 01 00 00 00 00 02 28 81 39 01 00 00 00 00 02 29 81 39 01 00 00 00 00 02 2a 81 39 01 00 00 00 00 02 2b 81 39 01 00 00 00 00 02 2c 81 39 01 00 00 00 00 02 2d 81 39 01 00 00 00 00 02 2e 81 39 01 00 00 00 00 02 2f 81 39 01 00 00 00 00 02 30 81 39 01 00 00 00 00 02 31 81 39 01 00 00 00 00 02 32 81 39 01 00 00 00 00 02 33 81 39 01 00 00 00 00 02 34 81 39 01 00 00 00 00 02 35 81 39 01 00 00 00 00 02 36 81 39 01 00 00 00 00 02 37 81 39 01 00 00 00 00 02 38 81 39 01 00 00 00 00 02 39 81 39 01 00 00 00 00 02 3a 81 39 01 00 00 00 00 02 3b 81 39 01 00 00 00 00 02 3c 81 39 01 00 00 00 00 02 3d 81 39 01 00 00 00 00 02 3e 81 39 01 00 00 00 00 02 3f 81 39 01 00 00 00 00 02 40 81 39 01 00 00 00 00 02 41 81 39 01 00 00 00 00 02 42 81 39 01 00 00 00 00 02 43 81 39 01 00 00 00 00 02 44 81 39 01 00 00 00 00 02 45 81 39 01 00 00 00 00 02 46 81 39 01 00 00 00 00 02 47 81 39 01 00 00 00 00 02 48 81 39 01 00 00 00 00 02 49 81 39 01 00 00 00 00 02 4a 81 39 01 00 00 00 00 02 4b 81 39 01 00 00 00 00 02 4c 81 39 01 00 00 00 00 02 4d 81 39 01 00 00 00 00 02 4e 81 39 01 00 00 00 00 02 4f 81 39 01 00 00 00 00 02 50 81 39 01 00 00 00 00 02 51 81 39 01 00 00 00 00 02 52 81 39 01 00 00 00 00 02 53 81 39 01 00 00 00 00 02 54 81 39 01 00 00 00 00 02 55 81 39 01 00 00 00 00 02 56 81 39 01 00 00 00 00 02 57 81 39 01 00 00 00 00 02 58 81 39 01 00 00 00 00 02 59 81 39 01 00 00 00 00 02 5a 81 39 01 00 00 00 00 02 5b 81 39 01 00 00 00 00 02 5c 81 39 01 00 00 00 00 02 5d 81 39 01 00 00 00 00 02 5e 81 39 01 00 00 00 00 02 5f 81 39 01 00 00 00 00 02 60 81 39 01 00 00 00 00 02 61 81 39 01 00 00 00 00 02 62 81 39 01 00 00 00 00 02 63 81 39 01 00 00 00 00 02 64 81 39 01 00 00 00 00 02 65 81 39 01 00 00 00 00 02 66 81 39 01 00 00 00 00 02 67 81 39 01 00 00 00 00 02 68 81 39 01 00 00 00 00 02 69 81 39 01 00 00 00 00 02 6a 81 39 01 00 00 00 00 02 6b 81 39 01 00 00 00 00 02 6c 81 39 01 00 00 00 00 02 6d 81 39 01 00 00 00 00 02 6e 81 39 01 00 00 00 00 02 6f 81 39 01 00 00 00 00 02 70 81 39 01 00 00 00 00 02 71 81 39 01 00 00 00 00 02 72 81 39 01 00 00 00 00 02 73 81 39 01 00 00 00 00 02 74 81 39 01 00 00 00 00 02 75 81 39 01 00 00 00 00 02 76 81 39 01 00 00 00 00 02 77 81 39 01 00 00 00 00 02 78 81 39 01 00 00 00 00 02 79 81 39 01 00 00 00 00 02 7a 81 39 01 00 00 00 00 02 7b 81 39 01 00 00 00 00 02 7c 81 39 01 00 00 00 00 02 7d 81 39 01 00 00 00 00 02 7e 81 39 01 00 00 00 00 02 7f 81 39 01 00 00 00 00 04 ff 98 81 01 39 01 00 00 00 00 02 f3 01 39 01 00 00 00 00 04 ff 98 81 02 39 01 00 00 00 00 02 06 20 39 01 00 00 00 00 02 07 00 39 01 00 00 00 00 04 ff 98 81 00 39 01 00 00 00 00 03 51 0f ff 39 01 00 00 00 00 02 53 2c 39 01 00 00 00 00 02 55 80 39 01 00 00 00 00 02 35 00 05 01 00 00 78 00 02 11 00 05 01 00 00 14 00 02 29 00];
	qcom,mdss-dsi-init-delay-us = <0xc350>;
	qcom,mdss-dsi-bl-pmic-control-type = "bl_ctrl_wled";
	qcom,mdss-dsi-panel-name = "oppo15399boe ili9881c 720p video mode dsi panel";
	qcom,mdss-dsi-h-pulse-width = <0x02>;
	qcom,mdss-dsi-color-order = "rgb_swap_rgb";
	qcom,mdss-dsi-v-bottom-border = <0x00>;
	qcom,mdss-dsi-border-color = <0x00>;
	qcom,mdss-dsi-v-pulse-width = <0x08>;
	qcom,mdss-dsi-cabc-off-command = <0x39010000 0x4ff 0x98810105 0x1000078 0x2f301 0x39010000 0x4ff 0x98810005 0x1000078 0x22900>;
	qcom,mdss-dsi-cabc-video-command = <0x39010000 0x4ff 0x98810105 0x1000078 0x2f301 0x39010000 0x4ff 0x98810005 0x1000078 0x22900>;
	qcom,mdss-dsi-virtual-channel-id = <0x00>;
	qcom,mdss-dsi-panel-timings = <0xbc2a1c00 0x5458202e 0x20030400>;
	qcom,mdss-dsi-lane-0-state;
	qcom,mdss-dsi-h-sync-pulse = <0x01>;
	qcom,esd-check-enabled;
	qcom,mdss-dsi-cabc-ui-command = <0x39010000 0x4ff 0x98810105 0x1000078 0x2f301 0x39010000 0x4ff 0x98810005 0x1000078 0x22900>;
	qcom,mdss-dsi-panel-status-command-state = "dsi_lp_mode";
	qcom,mdss-dsi-dma-trigger = "trigger_sw";
	qcom,mdss-dsi-panel-controller = <&mdss_dsi0>;
	};

	dsi_oppo15399tm_nt35521s: qcom,mdss_dsi_oppo15399tm_nt35521s_720p_video {
	qcom,mdss-dsi-bllp-power-mode;
	qcom,mdss-dsi-lp11-init;
	qcom,mdss-dsi-panel-status-check-mode = "reg_read";
	qcom,mdss-dsi-lane-2-state;
	qcom,mdss-dsi-panel-width = <0x2d0>;
	qcom,mdss-dsi-bl-min-level = <0x10>;
	qcom,mdss-dsi-h-back-porch = <0xe6>;
	qcom,mdss-dsi-bpp = <0x18>;
	qcom,cont-splash-enabled;
	qcom,mdss-dsi-mdp-trigger = <0x00>;
	qcom,mdss-dsi-bllp-eof-power-mode;
	qcom,mdss-dsi-v-top-border = <0x00>;
	qcom,mdss-dsi-v-front-porch = <0x1a>;
	qcom,mdss-dsi-panel-status-command = [06 01 00 01 05 00 02 0a 08];
	qcom,mdss-dsi-stream = <0x00>;
	qcom,mdss-dsi-hsa-power-mode;
	qcom,mdss-dsi-bl-max-level = <0xf0>;
	qcom,mdss-pan-physical-height-dimension = <0x6e>;
	qcom,mdss-dsi-hbp-power-mode;
	qcom,mdss-dsi-panel-version = "NT35521S";
	qcom,mdss-dsi-tx-eot-append;
	qcom,mdss-dsi-pixel-packing = "tight";
	qcom,mdss-dsi-lane-1-state;
	qcom,mdss-dsi-v-back-porch = <0x1a>;
	qcom,mdss-dsi-reset-sequence = <0x01 0x0a 0x00 0x01 0x01 0x0f>;
	qcom,mdss-dsi-on-command-state = "dsi_lp_mode";
	qcom,mdss-dsi-panel-type = "dsi_video_mode";
	qcom,mdss-dsi-h-right-border = <0x00>;
	qcom,mdss-dsi-off-command = [05 01 00 00 32 00 02 28 00 05 01 00 00 78 00 02 10 00];
	qcom,mdss-dsi-traffic-mode = "burst_mode";
	qcom,mdss-dsi-t-clk-pre = <0x29>;
	qcom,mdss-dsi-lane-map = "lane_map_0123";
	qcom,mdss-dsi-hfp-power-mode;
	qcom,mdss-dsi-h-front-porch = <0xf0>;
	qcom,mdss-dsi-panel-destination = "display_1";
	qcom,mdss-dsi-panel-height = <0x500>;
	qcom,mdss-dsi-panel-status-value = <0x9c>;
	qcom,mdss-dsi-h-sync-skew = <0x00>;
	qcom,mdss-pan-physical-width-dimension = <0x3e>;
	qcom,mdss-dsi-h-left-border = <0x00>;
	qcom,mdss-dsi-panel-framerate = <0x3c>;
	qcom,mdss-dsi-cabc-still-image-command = [15 01 00 00 10 00 02 55 02 05 01 00 00 10 00 02 29 00];
	qcom,mdss-dsi-off-command-state = "dsi_hs_mode";
	qcom,mdss-dsi-underflow-color = <0xff>;
	qcom,mdss-dsi-t-clk-post = <0x04>;
	qcom,mdss-dsi-panel-manufacture = "TM_0420";
	qcom,mdss-dsi-on-command = [39 01 00 00 00 00 05 ff aa 55 25 01 39 01 00 00 00 00 02 6f 16 39 01 00 00 00 00 02 f7 10 39 01 00 00 00 00 05 ff aa 55 25 00 39 01 00 00 00 00 06 f0 55 aa 52 08 00 39 01 00 00 00 00 02 6f 02 39 01 00 00 00 00 02 b8 01 39 01 00 00 00 00 02 ec 05 39 01 00 00 00 00 03 bb aa aa 39 01 00 00 00 00 03 bc 00 00 39 01 00 00 00 00 02 c8 80 39 01 00 00 00 00 02 b6 06 39 01 00 00 00 00 06 f0 55 aa 52 08 01 39 01 00 00 00 00 03 b0 0f 0f 39 01 00 00 00 00 03 b1 0f 0f 39 01 00 00 00 00 03 bc 78 00 39 01 00 00 00 00 03 bd 78 00 39 01 00 00 00 00 02 ca 00 39 01 00 00 00 00 02 c0 04 39 01 00 00 00 00 03 b5 03 03 39 01 00 00 00 00 03 b3 1e 1e 39 01 00 00 00 00 03 b4 0f 0f 39 01 00 00 00 00 03 b9 34 34 39 01 00 00 00 00 03 ba 15 15 39 01 00 00 00 00 06 f0 55 aa 52 08 02 39 01 00 00 00 00 02 ee 03 39 01 00 00 00 00 11 b0 00 00 00 16 00 3a 00 56 00 6d 00 94 00 b3 00 e6 39 01 00 00 00 00 11 b1 01 0f 01 4f 01 82 01 d5 02 1a 02 1c 02 5d 02 a2 39 01 00 00 00 00 11 b2 02 cb 03 00 03 22 03 50 03 6d 03 92 03 ab 03 c1 39 01 00 00 00 00 05 b3 03 d1 03 d3 39 01 00 00 00 00 11 b4 00 9f 00 a7 00 b5 00 c2 00 ce 00 e4 00 f9 01 22 39 01 00 00 00 00 11 b5 01 42 01 72 01 9d 01 e9 02 26 02 28 02 65 02 a8 39 01 00 00 00 00 11 b6 02 d0 03 03 03 26 03 50 03 6d 03 91 03 a8 03 bf 39 01 00 00 00 00 05 b7 03 d0 03 d3 39 01 00 00 00 00 11 b8 00 5c 00 66 00 78 00 88 00 97 00 b2 00 cb 00 fb 39 01 00 00 00 00 11 b9 01 20 01 57 01 87 01 db 02 1c 02 1e 02 5e 02 a4 39 01 00 00 00 00 11 ba 02 cd 03 01 03 26 03 5a 03 83 03 a9 03 b0 03 bf 39 01 00 00 00 00 05 bb 03 d1 03 d3 39 01 00 00 00 00 06 f0 55 aa 52 08 06 39 01 00 00 00 00 03 b0 08 34 39 01 00 00 00 00 03 b1 31 34 39 01 00 00 00 00 03 b2 34 2e 39 01 00 00 00 00 03 b3 2d 34 39 01 00 00 00 00 03 b4 00 02 39 01 00 00 00 00 03 b5 34 12 39 01 00 00 00 00 03 b6 10 34 39 01 00 00 00 00 03 b7 34 18 39 01 00 00 00 00 03 b8 16 34 39 01 00 00 00 00 03 b9 34 34 39 01 00 00 00 00 03 ba 34 34 39 01 00 00 00 00 03 bb 34 17 39 01 00 00 00 00 03 bc 19 34 39 01 00 00 00 00 03 bd 34 11 39 01 00 00 00 00 03 be 13 34 39 01 00 00 00 00 03 bf 03 01 39 01 00 00 00 00 03 c0 34 2d 39 01 00 00 00 00 03 c1 2e 34 39 01 00 00 00 00 03 c2 34 31 39 01 00 00 00 00 03 c3 34 09 39 01 00 00 00 00 03 e5 34 34 39 01 00 00 00 00 03 c4 09 34 39 01 00 00 00 00 03 c5 31 34 39 01 00 00 00 00 03 c6 34 2d 39 01 00 00 00 00 03 c7 2e 34 39 01 00 00 00 00 03 c8 03 01 39 01 00 00 00 00 03 c9 34 17 39 01 00 00 00 00 03 ca 19 34 39 01 00 00 00 00 03 cb 34 11 39 01 00 00 00 00 03 cc 13 34 39 01 00 00 00 00 03 cd 34 34 39 01 00 00 00 00 03 ce 34 34 39 01 00 00 00 00 03 cf 34 12 39 01 00 00 00 00 03 d0 10 34 39 01 00 00 00 00 03 d1 34 18 39 01 00 00 00 00 03 d2 16 34 39 01 00 00 00 00 03 d3 00 02 39 01 00 00 00 00 03 d4 34 2e 39 01 00 00 00 00 03 d5 2d 34 39 01 00 00 00 00 03 d6 34 31 39 01 00 00 00 00 03 d7 34 08 39 01 00 00 00 00 03 e6 34 34 39 01 00 00 00 00 06 d8 00 00 00 00 00 39 01 00 00 00 00 06 d9 00 00 00 00 00 39 01 00 00 00 00 02 e7 00 39 01 00 00 00 00 06 f0 55 aa 52 08 05 39 01 00 00 00 00 02 ed 30 39 01 00 00 00 00 06 f0 55 aa 52 08 03 39 01 00 00 00 00 03 b1 20 00 39 01 00 00 00 00 03 b0 20 00 39 01 00 00 00 00 06 f0 55 aa 52 08 05 39 01 00 00 00 00 02 e5 00 39 01 00 00 00 00 06 f0 55 aa 52 08 05 39 01 00 00 00 00 03 b0 17 06 39 01 00 00 00 00 02 b8 00 39 01 00 00 00 00 06 bd 03 03 01 00 03 39 01 00 00 00 00 03 b1 17 06 39 01 00 00 00 00 03 b9 00 03 39 01 00 00 00 00 03 b2 17 06 39 01 00 00 00 00 03 ba 00 00 39 01 00 00 00 00 03 b3 17 06 39 01 00 00 00 00 03 bb 00 00 39 01 00 00 00 00 03 b4 17 06 39 01 00 00 00 00 03 b5 17 06 39 01 00 00 00 00 03 b6 17 06 39 01 00 00 00 00 03 b7 17 06 39 01 00 00 00 00 03 bc 00 03 39 01 00 00 00 00 02 e5 06 39 01 00 00 00 00 02 e6 06 39 01 00 00 00 00 02 e7 06 39 01 00 00 00 00 02 e8 06 39 01 00 00 00 00 02 e9 06 39 01 00 00 00 00 02 ea 06 39 01 00 00 00 00 02 eb 06 39 01 00 00 00 00 02 ec 06 39 01 00 00 00 00 06 f0 55 aa 52 08 05 39 01 00 00 00 00 02 c0 0b 39 01 00 00 00 00 02 c1 09 39 01 00 00 00 00 02 c2 0b 39 01 00 00 00 00 02 c3 09 39 01 00 00 00 00 06 f0 55 aa 52 08 03 39 01 00 00 00 00 06 b2 05 00 00 00 00 39 01 00 00 00 00 06 b3 05 00 00 00 00 39 01 00 00 00 00 06 b4 05 00 00 00 00 39 01 00 00 00 00 06 b5 05 00 00 00 00 39 01 00 00 00 00 06 f0 55 aa 52 08 05 39 01 00 00 00 00 02 c4 0f 39 01 00 00 00 00 02 c5 0f 39 01 00 00 00 00 02 c6 0f 39 01 00 00 00 00 02 c7 0f 39 01 00 00 00 00 06 f0 55 aa 52 08 03 39 01 00 00 00 00 06 b6 05 00 00 00 00 39 01 00 00 00 00 06 b7 05 00 00 00 00 39 01 00 00 00 00 06 b8 05 00 00 00 00 39 01 00 00 00 00 06 b9 05 00 00 00 00 39 01 00 00 00 00 06 f0 55 aa 52 08 05 39 01 00 00 00 00 03 c8 07 20 39 01 00 00 00 00 03 c9 03 20 39 01 00 00 00 00 03 ca 07 00 39 01 00 00 00 00 03 cb 03 00 39 01 00 00 00 00 06 f0 55 aa 52 08 03 39 01 00 00 00 00 06 ba 53 00 00 00 00 39 01 00 00 00 00 06 bb 53 00 00 00 00 39 01 00 00 00 00 06 bc 53 00 00 00 00 39 01 00 00 00 00 06 bd 53 00 00 00 00 39 01 00 00 00 00 06 f0 55 aa 52 08 05 39 01 00 00 00 00 06 d1 00 05 00 07 10 39 01 00 00 00 00 06 d2 00 05 04 07 10 39 01 00 00 00 00 06 d3 00 00 0a 07 10 39 01 00 00 00 00 06 d4 00 00 0a 07 10 39 01 00 00 00 00 06 f0 55 aa 52 08 05 39 01 00 00 00 00 08 d0 00 00 00 00 00 00 00 39 01 00 00 00 00 0c d5 00 00 00 00 00 00 00 00 00 00 00 39 01 00 00 00 00 0c d6 00 00 00 00 00 00 00 00 00 00 00 39 01 00 00 00 00 0c d7 00 00 00 00 00 00 00 00 00 00 00 39 01 00 00 00 00 06 d8 00 00 00 00 00 39 01 00 00 00 00 06 f0 55 aa 52 08 03 39 01 00 00 00 00 02 c4 60 39 01 00 00 00 00 02 c5 40 39 01 00 00 00 00 02 c6 60 39 01 00 00 00 00 02 c7 40 39 01 00 00 00 00 02 6f 01 39 01 00 00 00 00 02 f9 46 39 01 00 00 00 00 06 f0 55 aa 52 08 04 39 01 00 00 00 00 02 c3 83 39 01 00 00 00 00 06 f0 55 aa 52 08 00 39 01 00 00 00 00 02 c8 80 39 01 00 00 00 00 04 d9 01 01 4d 39 01 00 00 00 00 02 51 ff 39 01 00 00 00 00 02 53 24 39 01 00 00 00 00 02 55 81 39 01 00 00 00 00 06 f0 55 aa 52 08 00 39 01 00 00 00 00 07 cc 40 36 87 00 00 00 39 01 00 00 00 00 0d ce 10 10 10 10 10 10 10 10 10 10 10 10 39 01 00 00 00 00 11 d1 00 02 03 04 06 08 0a 0c 0e 0e 0c 0a 08 04 02 00 05 01 00 00 78 00 02 11 00 05 01 00 00 14 00 02 29 00];
	qcom,mdss-dsi-init-delay-us = <0xc350>;
	qcom,mdss-dsi-bl-pmic-control-type = "bl_ctrl_wled";
	qcom,mdss-dsi-panel-name = "oppo15399tm nt35521s 720p video mode dsi panel";
	qcom,mdss-dsi-h-pulse-width = <0x08>;
	qcom,mdss-dsi-color-order = "rgb_swap_rgb";
	qcom,mdss-dsi-v-bottom-border = <0x00>;
	qcom,mdss-dsi-border-color = <0x00>;
	qcom,mdss-dsi-v-pulse-width = <0x08>;
	qcom,mdss-dsi-cabc-off-command = [15 01 00 00 10 00 02 55 00 05 01 00 00 10 00 02 29 00];
	qcom,mdss-dsi-cabc-video-command = [15 01 00 00 10 00 02 55 03 05 01 00 00 10 00 02 29 00];
	qcom,mdss-dsi-virtual-channel-id = <0x00>;
	qcom,mdss-dsi-panel-timings = <0xe2302000 0x5c622434 0x26030400>;
	qcom,mdss-dsi-lane-0-state;
	qcom,mdss-dsi-h-sync-pulse = <0x01>;
	qcom,esd-check-enabled;
	qcom,mdss-dsi-cabc-ui-command = [15 01 00 00 10 00 02 55 01 05 01 00 00 10 00 02 29 00];
	qcom,mdss-dsi-panel-status-command-state = "dsi_lp_mode";
	qcom,mdss-dsi-dma-trigger = "trigger_sw";
	qcom,mdss-dsi-panel-controller = <&mdss_dsi0>;
	};

	dsi_oppo15399truly_nt35521s: qcom,mdss_dsi_oppo15399truly_nt35521s_720p_video {
	qcom,mdss-dsi-bllp-power-mode;
	qcom,mdss-dsi-lp11-init;
	qcom,mdss-dsi-panel-status-check-mode = "reg_read";
	qcom,mdss-dsi-lane-2-state;
	qcom,mdss-dsi-panel-width = <0x2d0>;
	qcom,mdss-dsi-bl-min-level = <0x01>;
	qcom,mdss-dsi-h-back-porch = <0xe6>;
	qcom,mdss-dsi-bpp = <0x18>;
	qcom,cont-splash-enabled;
	qcom,mdss-dsi-mdp-trigger = <0x00>;
	qcom,mdss-dsi-bllp-eof-power-mode;
	qcom,mdss-dsi-v-top-border = <0x00>;
	qcom,mdss-dsi-v-front-porch = <0x1a>;
	qcom,mdss-dsi-panel-status-command = [06 01 00 01 05 00 02 0a 08];
	qcom,mdss-dsi-stream = <0x00>;
	qcom,mdss-dsi-hsa-power-mode;
	qcom,mdss-dsi-bl-max-level = <0xff>;
	qcom,mdss-pan-physical-height-dimension = <0x6e>;
	qcom,mdss-dsi-hbp-power-mode;
	qcom,mdss-dsi-panel-version = "NT35521S";
	qcom,mdss-dsi-tx-eot-append;
	qcom,mdss-dsi-pixel-packing = "tight";
	qcom,mdss-dsi-lane-1-state;
	qcom,mdss-dsi-v-back-porch = <0x1a>;
	qcom,mdss-dsi-reset-sequence = <0x01 0x0a 0x00 0x01 0x01 0x0f>;
	qcom,mdss-dsi-on-command-state = "dsi_lp_mode";
	qcom,mdss-dsi-panel-type = "dsi_video_mode";
	qcom,mdss-dsi-h-right-border = <0x00>;
	qcom,mdss-dsi-off-command = [05 01 00 00 32 00 02 28 00 05 01 00 00 78 00 02 10 00];
	qcom,mdss-dsi-traffic-mode = "burst_mode";
	qcom,mdss-dsi-t-clk-pre = <0x29>;
	qcom,mdss-dsi-lane-map = "lane_map_0123";
	qcom,mdss-dsi-hfp-power-mode;
	qcom,mdss-dsi-h-front-porch = <0xf0>;
	qcom,mdss-dsi-panel-destination = "display_1";
	qcom,mdss-dsi-panel-height = <0x500>;
	qcom,mdss-dsi-panel-status-value = <0x9c>;
	qcom,mdss-dsi-h-sync-skew = <0x00>;
	qcom,mdss-pan-physical-width-dimension = <0x3e>;
	qcom,mdss-dsi-h-left-border = <0x00>;
	qcom,mdss-dsi-panel-framerate = <0x3c>;
	qcom,mdss-dsi-cabc-still-image-command = [15 01 00 00 10 00 02 55 02 05 01 00 00 10 00 02 29 00];
	qcom,mdss-dsi-off-command-state = "dsi_hs_mode";
	qcom,mdss-dsi-underflow-color = <0xff>;
	qcom,mdss-dsi-t-clk-post = <0x04>;
	qcom,mdss-dsi-panel-manufacture = "TRULY";
	qcom,mdss-dsi-on-command = <0x39010000 0x6f0 0x55aa5208 0x390100 0x03 0xb1682139 0x1000000 0x2b601 0x39010000 0x5b8 0x1020802 0x39010000 0x3bb 0x11113901 0x00 0x3bc0000 0x39010000 0x6f0 0x55aa5208 0x1390100 0x03 0xb00f0f39 0x1000000 0x3b10f 0xf390100 0x03 0xb3282839 0x1000000 0x3b419 0x19390100 0x03 0xb5050539 0x1000000 0x3b944 0x44390100 0x03 0xba242439 0x1000000 0x3bc88 0x390100 0x03 0xbd880039 0x1000000 0x2be44 0x39010000 0x2c0 0xc390100 0x02 0xca003901 0x00 0x6f055aa 0x52080239 0x1000000 0x2ee00 0x39010000 0x11b0 0x9500aa 0xc800e0 0xf50117 0x1310160 0x39010000 0x11b1 0x18401ba 0x1e40223 0x2520253 0x28502be 0x39010000 0x11b2 0x2de030e 0x32e0352 0x3700391 0x3a103b3 0x39010000 0x5b3 0x3c503d8 0x39010000 0x11b4 0x9500aa 0xc800e0 0xf50117 0x1310160 0x39010000 0x11b5 0x18401ba 0x1e40223 0x2520253 0x28502be 0x39010000 0x11b6 0x2de030e 0x32e0352 0x3700391 0x3a103b3 0x39010000 0x5b7 0x3c503d8 0x39010000 0x11b8 0x9500aa 0xc800e0 0xf50117 0x1310160 0x39010000 0x11b9 0x18401ba 0x1e40223 0x2520253 0x28502be 0x39010000 0x11ba 0x2de030e 0x32e0352 0x3700391 0x3a103b3 0x39010000 0x5bb 0x3c503d8 0x39010000 0x11bc 0x45005b 0x7a0094 0xaa00cf 0xeb011f 0x39010000 0x11bd 0x1480188 0x1bc020f 0x2510253 0x28502be 0x39010000 0x11be 0x2de030e 0x32e0352 0x3700391 0x3a103b3 0x39010000 0x5bf 0x3c503fc 0x39010000 0x11c0 0x45005b 0x7a0094 0xaa00cf 0xeb011f 0x39010000 0x11c1 0x1480188 0x1bc020f 0x2510253 0x28502be 0x39010000 0x11c2 0x2de030e 0x32e0352 0x3700391 0x3a103b3 0x39010000 0x5c3 0x3c503fc 0x39010000 0x11c4 0x45005b 0x7a0094 0xaa00cf 0xeb011f 0x39010000 0x11c5 0x1480188 0x1bc020f 0x2510253 0x28502be 0x39010000 0x11c6 0x2de030e 0x32e0352 0x3700391 0x3a103b3 0x39010000 0x5c7 0x3c503fc 0x39010000 0x6f0 0x55aa5208 0x3390100 0x03 0xb0200039 0x1000000 0x3b120 0x390100 0x06 0xb2040052 0x1513901 0x00 0x6b30400 0x52015139 0x1000000 0x6b604 0x520151 0x39010000 0x6b7 0x4005201 0x51390100 0x06 0xba440060 0x1723901 0x00 0x6bb4400 0x60017239 0x1000000 0x6bc53 0x30048 0x39010000 0x6bd 0x53000300 0x48390100 0x02 0xc4403901 0x00 0x2c54039 0x1000000 0x6f055 0xaa520805 0x39010000 0x3b0 0x17063901 0x00 0x2b80039 0x1000000 0x6bd0f 0x3030003 0x39010000 0x3b1 0x17063901 0x00 0x2b90039 0x1000000 0x3b217 0x6390100 0x02 0xba003901 0x00 0x3b31706 0x39010000 0x2bb 0x390100 0x03 0xb4170639 0x1000000 0x3b517 0x6390100 0x03 0xb6170639 0x1000000 0x3b717 0x6390100 0x02 0xbc003901 0x00 0x2e50639 0x1000000 0x2e606 0x39010000 0x2e7 0x6390100 0x02 0xe8063901 0x00 0x2e90a39 0x1000000 0x2ea06 0x39010000 0x2eb 0x6390100 0x02 0xec063901 0x00 0x2ed3039 0x1000000 0x2c007 0x39010000 0x2c1 0x5390100 0x02 0xc4823901 0x00 0x2c58039 0x1000000 0x3c803 0x20390100 0x03 0xc9012139 0x1000000 0x3ca03 0x20390100 0x03 0xcb072039 0x1000000 0xcd103 0x5000500 0x00 0x3901 0x00 0xcd20305 0x30000 0x00 0x390100 0x0c 0xd3030504 0x5000000 0x00 0x39010000 0xcd4 0x3050403 0x00 0x39 0x1000000 0x6f055 0xaa520806 0x39010000 0x3b0 0x2e2e3901 0x00 0x3b12e2e 0x39010000 0x3b2 0x2e2e3901 0x00 0x3b32e09 0x39010000 0x3b4 0xb233901 0x00 0x3b51d1f 0x39010000 0x3b6 0x11173901 0x00 0x3b71319 0x39010000 0x3b8 0x1033901 0x00 0x3b92e2e 0x39010000 0x3ba 0x2e2e3901 0x00 0x3bb0200 0x39010000 0x3bc 0x18123901 0x00 0x3bd1610 0x39010000 0x3be 0x1e1c3901 0x00 0x3bf220a 0x39010000 0x3c0 0x82e3901 0x00 0x3c12e2e 0x39010000 0x3c2 0x2e2e3901 0x00 0x3c32e2e 0x39010000 0x3e5 0x25243901 0x00 0x3c42e2e 0x39010000 0x3c5 0x2e2e3901 0x00 0x3c62e2e 0x39010000 0x3c7 0x2e023901 0x00 0x3c80024 0x39010000 0x3c9 0x1e1c3901 0x00 0x3ca1812 0x39010000 0x3cb 0x16103901 0x00 0x3cc0a08 0x39010000 0x3cd 0x2e2e3901 0x00 0x3ce2e2e 0x39010000 0x3cf 0x90b3901 0x00 0x3d01117 0x39010000 0x3d1 0x13193901 0x00 0x3d21d1f 0x39010000 0x3d3 0x25013901 0x00 0x3d4032e 0x39010000 0x3d5 0x2e2e3901 0x00 0x3d62e2e 0x39010000 0x3d7 0x2e2e3901 0x00 0x3e62223 0x39010000 0x6d8 0x00 0x390100 0x06 0xd9000000 0x3901 0x00 0x2e70039 0x1000000 0x251ff 0x39010000 0x253 0x2c390100 0x02 0x55013901 0x00 0x5ffaa55 0x25013901 0x00 0x26f1639 0x1000000 0x2f710 0x39010000 0x5ff 0xaa552500 0x39010000 0x6ff 0x55aa5208 0x4390100 0x04 0xc2806000 0x39010000 0x6ff 0x55aa5208 0x390100 0x02 0xc8800501 0xc800 0x2110005 0x1000078 0x22900>;
	qcom,mdss-dsi-init-delay-us = <0xc350>;
	qcom,mdss-dsi-bl-pmic-control-type = "bl_ctrl_wled";
	qcom,mdss-dsi-panel-name = "oppo15399truly nt35521s 720p video mode dsi panel";
	qcom,mdss-dsi-h-pulse-width = <0x08>;
	qcom,mdss-dsi-color-order = "rgb_swap_rgb";
	qcom,mdss-dsi-v-bottom-border = <0x00>;
	qcom,mdss-dsi-border-color = <0x00>;
	qcom,mdss-dsi-v-pulse-width = <0x08>;
	qcom,mdss-dsi-cabc-off-command = [15 01 00 00 10 00 02 55 00 05 01 00 00 10 00 02 29 00];
	qcom,mdss-dsi-cabc-video-command = [15 01 00 00 10 00 02 55 03 05 01 00 00 10 00 02 29 00];
	qcom,mdss-dsi-virtual-channel-id = <0x00>;
	qcom,mdss-dsi-panel-timings = <0xe2302000 0x5c622434 0x26030400>;
	qcom,mdss-dsi-lane-0-state;
	qcom,mdss-dsi-h-sync-pulse = <0x01>;
	qcom,esd-check-enabled;
	qcom,mdss-dsi-cabc-ui-command = [15 01 00 00 10 00 02 55 01 05 01 00 00 10 00 02 29 00];
	qcom,mdss-dsi-panel-status-command-state = "dsi_lp_mode";
	qcom,mdss-dsi-dma-trigger = "trigger_sw";
	qcom,mdss-dsi-panel-controller = <&mdss_dsi0>;
	};

};
