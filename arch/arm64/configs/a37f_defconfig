## arch/arm64/configs/a37f_defconfig
```kconfig
# Base: msm_defconfig + BPF + Android features
CONFIG_ARCH_MSM=y
CONFIG_ARCH_MSM8916=y
CONFIG_BPF=y
CONFIG_BPF_SYSCALL=y
CONFIG_BPF_JIT=y
CONFIG_HAVE_EBPF_JIT=y
CONFIG_CGROUP_BPF=y
CONFIG_BPF_EVENTS=y
CONFIG_BPF_UNPRIV_DEFAULT_OFF=y
CONFIG_NETFILTER_XT_MATCH_BPF=y
CONFIG_NET_CLS_BPF=y
CONFIG_NET_ACT_BPF=y
CONFIG_ANDROID=y
CONFIG_ANDROID_BINDER_IPC=y
CONFIG_ANDROID_BINDER_DEVICES="binder,hwbinder,vndbinder"
CONFIG_ASHMEM=y
CONFIG_SECURITY_SELINUX=y
```

## drivers/soc/oppo/Kconfig
```kconfig
# OPPO SoC drivers, ported from the stock OPPO A37f (msm8916) 3.10 kernel.
config OPPO_ARCH_FILE
	bool "Build the drivers/soc/oppo directory"
	help
	  Say Y to build in the OPPO soc/oppo drivers directory.

config OPPO_COMMON_SOFT
	bool "OPPO common software (project version from shared memory)"
	select OPPO_ARCH_FILE
	help
	  Read the OPPO project/PCB/operator version from SMEM (SMEM_ID_VENDOR1),
	  exposing is_project()/get_PCB_Version() and /proc/oppoVersion/*.

source "drivers/soc/oppo/oppo_project/Kconfig"

config OPPO_DEVICE_IFNO
	bool "OPPO device-info (/proc/devinfo board straps)"
	select OPPO_ARCH_FILE
	help
	  Register board/mainboard/DDR/PA identification under /proc/devinfo,
	  binding the "oppo-devinfo" platform node.

source "drivers/soc/oppo/oppo_devinfo/Kconfig"
```
